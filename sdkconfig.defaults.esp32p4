## sdkconfig.defaults.esp32p4
```kconfig
# ESP32-P4 PSRAM Configuration for Camera
CONFIG_SPIRAM=y
CONFIG_SPIRAM_MODE_OCT=y
CONFIG_SPIRAM_SPEED_200M=y
CONFIG_SPIRAM_BOOT_INIT=y
CONFIG_SPIRAM_USE_MALLOC=y
CONFIG_SPIRAM_TRY_ALLOCATE_WIFI_LWIP=y
CONFIG_SPIRAM_MALLOC_ALWAYSINTERNAL=16384
CONFIG_SPIRAM_MALLOC_RESERVE_INTERNAL=32768

# SD Card Configuration
CONFIG_FATFS_VOLUME_COUNT=2
CONFIG_FATFS_ALLOC_PREFER_EXTRAM=y
CONFIG_FATFS_USE_FASTSEEK=y
CONFIG_FATFS_PER_FILE_CACHE=y
```
